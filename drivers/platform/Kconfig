## drivers/platform/Kconfig
```kconfig
# SPDX-License-Identifier: GPL-2.0-only


source "drivers/platform/goldfish/Kconfig"

source "drivers/platform/chrome/Kconfig"

source "drivers/platform/cznic/Kconfig"

source "drivers/platform/mellanox/Kconfig"

source "drivers/platform/olpc/Kconfig"

source "drivers/platform/surface/Kconfig"


source "drivers/platform/arm64/Kconfig"

source "drivers/platform/raspberrypi/Kconfig"

source "drivers/platform/wmi/Kconfig"
```
